/*@!Encoding:936*/
includes
{
  
    #include "ETH_Test_Function.cin"
}

variables
{
    struct eth_header
    {
        qword dMAC;
        qword sMAC;
        word vlanID;
        word etherType;
    };
    
    struct ipv4_header
    {
        char sIPv4Addr_str[16];
        char dIPv4Addr_str[16];
        dword protocol;
        
    };
    
    struct ipv6_header
    {
        char sIPv6Addr_str[40];
        char dIPv6Addr_str[40];
        dword protocol;
    };
  
}





testcase Check_01f0_Cycle1()
{
    char bus[32]="EthernetCluster38_1";
    byte dir=1;
    char sMAC_str[32]="02:df:53:00:00:10";
    char dMAC_str[32]="02:df:53:00:00:00";
    word vlanID=11;
    char sIPv4_str[32]="172.16.111.50";
    char dIPv4_str[32]="172.16.111.10";
    dword sPort=56000;
    dword dPort=56000;
    dword flags=0;
    dword aTimeout=200;
    word cycle=100;
    float tolerance=0.1;
    
//    @S32G_M_010F::sub_key_010F=1;
    
    testWaitForTimeout(1000);
    
    testStep("","start check message 0x01f0");
    Check_SomeIP_Message_Cycle(bus, dir, cycle,tolerance,sMAC_str, dMAC_str, vlanID, sIPv4_str, dIPv4_str, sPort, dPort, flags, aTimeout);
}



void MainTest ()
{
    char sMAC_str[32]="20:00:00:00:00:01";
    char dMAC_str[32]="FF:FF:FF:FF:FF:FF";
    word vlanId=1;
    char sIPv4_str[32]="192.168.0.1";
    char dIPv4_str[32]="192.168.0.2";
    dword sPort=30490;
    dword dPort=30490;
    dword MessageID=0x10010001;//Service ID+Method ID
    dword RequestID=0x00010001;//Client ID+Session ID
    byte MessageType=0;
    byte date[2]={1,2};
    
    SendSomeIP_Request(sMAC_str,dMAC_str,vlanId,sIPv4_str,dIPv4_str,sPort,dPort,MessageID,RequestID,MessageType,date);
    
    
}

